## Kconfig
```kconfig
comment "Zephyr TPF module"

module = TPF_MODULE
module-str = tpf-module
source "subsys/logging/Kconfig.template.log_config"


config TPF_MODULE
    bool "TPF module"
    # default n

    # imply FLASH
    # imply FLASH_MAP
    # imply MPU_ALLOW_FLASH_WRITE

    select FLASH
    select FLASH_MAP
    # select STREAM_FLASH     # TODO: Можлицо це задіяти?
    select MPU_ALLOW_FLASH_WRITE

    select JSON_LIBRARY     # TODO: Можливо це можна буде зробити опціональним

    help
	    This option enables the TPF module.

if TPF_MODULE

# config APP_VERSION_STRING
#     string "Application version"
#     default "0.0.0"
#     help
#       Use this to set the application version.

config APP_CONFIG_VERSION
    string "Application configuration version"
    default "0.0.0"
    help
      Use this to set the application configuration version.

# config TPF_NET_SAMPLE_APP_MAX_CONNECTIONS
# 	int "Number of times to connect to the MQTT server"
# 	default 0
# 	help
# 	  Number of times to connect to the MQTT server. With each connection
# 	  send NET_SAMPLE_APP_MAX_ITERATIONS amount of MQTT sample messages.
# 	  A value of zero means to continue forever.

endif
```
